## arquivos_lesc/src/modules/regpeek/Kconfig
```kconfig
menuconfig MODULES_REGPEEK
	bool "regpeek"
	default n
	---help---
		Enable support for regpeek
```

## arquivos_lesc/src/modules/sepeek/Kconfig
```kconfig
menuconfig MODULES_SEPEEK
	bool "sepeek"
	default n
	---help---
		Enable support for sepeek
```

## Kconfig
```kconfig
menuconfig EXAMPLES_LESC_APP
    bool "lesc_app"
    default n
    ---help---
        Teste de aplicativo lesc
```

## arquivos_lesc/src/modules/gpiotoggle/Kconfig
```kconfig
menuconfig MODULES_GPIOTOGGLE
	bool "gpiotoggle"
	default y
	---help---
		Enable support for gpiotoggle
```

## arquivos_lesc/src/modules/phypeek/Kconfig
```kconfig
menuconfig MODULES_PHYPEEK
	bool "phypeek"
	default n
	---help---
		Enable support for phypeek
```
